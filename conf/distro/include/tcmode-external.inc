## conf/distro/include/tcmode-external.inc
```bitbake
# Allow overrides usage for tcmode
TCMODEOVERRIDES ?= "tcmode-external"
OVERRIDES_prepend_class-target = "${TCMODEOVERRIDES}:"
OVERRIDES_prepend_class-cross = "${TCMODEOVERRIDES}:"

# The alternative to these would be to retain entries in DEPENDS and restore the
# bits that obey it.
#
# Pull this in explicitly rather than via compilerlibs/gcc-runtime's DEPENDS
BASE_DEFAULT_DEPS_append_tcmode-external_class-target = " libgcc"
# Pull this in explicitly rather than via the libc's DEPENDS
BASE_DEFAULT_DEPS_append_tcmode-external_class-target = " linux-libc-headers"
# Pull this in explicitly rather than via gcc
BASE_DEFAULT_DEPS_append_tcmode-external_class-target = " virtual/${TARGET_PREFIX}binutils"
```

## conf/layer.conf
```bitbake
BBPATH .= ":${LAYERDIR}"
BBFILES += "${LAYERDIR}/recipes-*/*/*.bb \
            ${LAYERDIR}/recipes-*/*/*.bbappend"

# BBFILES_DYNAMIC += " \
#     core:${LAYERDIR}/dynamic-layers/oe-core/*/*/*.bb \
#     core:${LAYERDIR}/dynamic-layers/oe-core/*/*/*.bbappend \
# "

BBFILE_COLLECTIONS += "meta-external"
BBFILE_PATTERN_meta-external = "^${LAYERDIR}/"
BBFILE_PRIORITY_meta-external = "1"

LAYERDEPENDS_meta-external = "core"
LAYERSERIES_COMPAT_meta-external = "gatesgarth"
LAYERVERSION_meta-external = "1"
LAYERDIR_meta-external = "${LAYERDIR}"

# These will rebuild when EXTERNAL_TOOLCHAIN changes, but we don't want
# everything to rebuild in such a case.
SIGGEN_EXCLUDERECIPES_ABISAFE += "\
    gcc-external-cross \
    gcc-external-cross-${TARGET_ARCH} \
    binutils-external-cross  \
    binutils-external-cross-${TARGET_ARCH} \
"

# Needed for external_run() for PV & LICENSE in the recipes, to be able to parse
#INHERIT_append = " external-common"

# Fallback default for when the tcmode isn't sourced
#GCC_VERSION ?= "0.0"
```
